/dts-v1/;
/plugin/;

/ {
	compatible = "allwinner,sun8i-h3";

	fragment@0 {
		target = <&spi1>;
		__overlay__ {
			#address-cells = <1>;
			#size-cells = <0>;
			status = "okay";

			tft@0 {
				compatible = "ilitek,ili9341";
				status = "okay";
				reg = <0>;
				spi-max-frequency = <32000000>;
				dc-gpios = <&pio 0 6 0>;
				reset-gpios = <&pio 0 7 1>;
				rotate = <0>;
				bgr;
				fps = <60>;
				buswidth = <8>;
			};
		};
	};
};
